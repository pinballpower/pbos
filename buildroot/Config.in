## buildroot/Config.in
```kconfig
comment "Base packages"
source "$BR2_EXTERNAL_PBOS_PATH/package/pbos-base/Config.in"

comment "DMDReader"
source "$BR2_EXTERNAL_PBOS_PATH/package/dmdreader/Config.in"
source "$BR2_EXTERNAL_PBOS_PATH/package/dmdreader-pico/Config.in"
```

## buildroot/package/configtxt/Config.in
```kconfig
config BR2_PACKAGE_CONFIGTXT
	bool "configtxt"
        help
          enable all necessary modules in config.txt
	depends on BR2_PACKAGE_RPI_FIRMWARE
```

## buildroot/package/dmdreader-pico/Config.in
```kconfig
config BR2_PACKAGE_DMDREADER_PICO
	bool "dmdreader-pico"
        help
          RP2040 firmware for DMD interface

	select BR2_PACKAGE_OPENOCD
	select BR2_PACKAGE_OPENOCD_BCM2835
	select BR2_PACKAGE_OPENOCD_SYSFS
```

## buildroot/package/dmdreader/Config.in
```kconfig
config BR2_PACKAGE_DMDREADER
	bool "dmdreader"
        help
          DMD processing software

	select BR2_PACKAGE_BOOST
	select BR2_PACKAGE_BOOST_IOSTREAMS
	select BR2_PACKAGE_BOOST_LOG
	select BR2_PACKAGE_LIBGPIOD

	select BR2_PACKAGE_GLM
        select BR2_INSTALL_LIBSTDCPP

config BR2_PACKAGE_DMDREADER_OGL
        bool "enable OpenGL ES support"
        help
          enables support for OpenGL ES displays on Pi4
        depends on BR2_PACKAGE_DMDREADER
	select BR2_PACKAGE_MESA3D
	select BR2_PACKAGE_LIBDRM
	select BR2_PACKAGE_MESA3D_GALLIUM_DRIVER
	select BR2_PACKAGE_MESA3D_DRIVER
	select BR2_PACKAGE_MESA3D_GALLIUM_DRIVER_V3D
	select BR2_PACKAGE_MESA3D_GALLIUM_DRIVER_VC4
	select BR2_PACKAGE_MESA3D_OPENGL_EGL
	select BR2_PACKAGE_MESA3D_OPENGL_ES

config BR2_PACKAGE_DMDREADER_VIDEO
	bool "enable video player support"
        help
          enables support for videop player (required for PUP playback)
        depends on BR2_PACKAGE_DMDREADER
	select BR2_PACKAGE_FFMPEG
```

## buildroot/package/enablewifi/Config.in
```kconfig
config BR2_PACKAGE_ENABLEWIFI
        bool "enablewifi"
        help
          add WiFi packages

 	select BR2_PACKAGE_IW
 	select BR2_PACKAGE_WPA_SUPPLICANT
 	select BR2_PACKAGE_WPA_SUPPLICANT_NL80211
 	select BR2_PACKAGE_WPA_SUPPLICANT_PASSPHRASE
```

## buildroot/package/pbos-base/Config.in
```kconfig
config BR2_PACKAGE_PBOS_BASE
	bool "pbos-base"
        help
          install base PinballOS prerequisites

	select BR2_PACKAGE_DROPBEAR
	select BR2_PACKAGE_DROPBEAR_CLIENT
	select BR2_PACKAGE_DROPBEAR_DISABLE_REVERSEDNS
	select BR2_PACKAGE_DROPBEAR_SMALL
	select BR2_PACKAGE_BUSYBOX_SHOW_OTHERS
	select BR2_PACKAGE_BASH
	select BR2_PACKAGE_PROCPS_NG
	select BR2_PACKAGE_AVAHI
	select BR2_PACKAGE_AVAHI_DAEMON
	select BR2_PACKAGE_AVAHI_DEFAULT_SERVICES
	
```

## buildroot/package/pivid/Config.in
```kconfig
config BR2_PACKAGE_PIVID
	bool "pivid"
        help
          PIVID video player fpr Raspberry Pi

        select BR2_PACKAGE_LIBDRM
        select BR2_PACKAGE_FFMPEG
	select BR2_PACKAGE_DOCTEST
```
